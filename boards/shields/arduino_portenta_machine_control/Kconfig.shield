## boards/shields/arduino_portenta_machine_control/Kconfig.shield
```kconfig
# Copyright (c) 2026 Noah Christian
# SPDX-License-Identifier: Apache-2.0

config SHIELD_ARDUINO_PORTENTA_MACHINE_CONTROL
	def_bool $(shields_list_contains,arduino_portenta_machine_control)
```
