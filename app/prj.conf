## CMakeLists.txt
```
# Portenta Machine Control Explorer - application.
#
# A FREESTANDING Zephyr application: it lives here and builds against whatever
# west workspace ZEPHYR_BASE points at, rather than living inside one. The
# application is the thing under version control; the workspace is a toolchain.
#
# The reasoning behind the definitions below is in docs/CONFIG.md.
cmake_minimum_required(VERSION 3.20.0)

find_package(Zephyr REQUIRED HINTS $ENV{ZEPHYR_BASE})
project(pmc_explorer LANGUAGES C CXX)

# The HTTP service's resource table needs a linker section named after the
# service, which only the application knows. BOTH calls are needed: one
# supplies the section for the linker-script path, the other for the
# CMake-generated one.
zephyr_linker_sources(SECTIONS sections-rom.ld)
zephyr_linker_section(
  NAME http_resource_desc_pmc_service
  KVMA RAM_REGION GROUP RODATA_REGION
)

target_sources(app PRIVATE
    src/main.c
    src/shell_mcuboot.c
    src/shell_analog.c
    src/whoami.c
    src/whoami_core.c
    src/health.c
    src/net.c
    src/clock.c
    src/expander.c
    src/io_write.c
    src/auth.c
    src/ao.c
    src/temp.c
    src/rs485.c
    src/enc.c
    src/canbus.c
    src/canopen.c
    src/snapshot.c
    src/do_interlock.c
    src/persist.c
    src/httpd.c
    src/page_vars.cpp
    src/io_post.cpp
)

# Arduino_HTTP_HTML by PATH, deliberately, and not a vendored copy: the engine
# is shared with a sibling project on this bench and the Zephyr port of it
# lives there, so a copy taken in here would drift from the one whose tests
# run. It is a hard build requirement, like ZEPHYR_BASE.
set(HTMLTPL_DIR "${CMAKE_CURRENT_SOURCE_DIR}/../../Arduino_HTTP_HTML"
    CACHE PATH "Path to the Arduino_HTTP_HTML checkout")
if(NOT EXISTS "${HTMLTPL_DIR}/src/HtmlTplEngine.cpp")
  message(FATAL_ERROR
    "Arduino_HTTP_HTML not found at ${HTMLTPL_DIR}.\n"
    "The panel is a TEMPLATE rendered on the board, not markup assembled in C, "
    "so the engine is not optional. Clone it beside this repository or pass "
    "-DHTMLTPL_DIR=<path>.")
endif()

target_sources(app PRIVATE
    ${HTMLTPL_DIR}/src/HtmlTplEngine.cpp
    ${HTMLTPL_DIR}/src/HtmlTplVars.cpp
    ${HTMLTPL_DIR}/src/HtmlTplCsrf.cpp
    ${HTMLTPL_DIR}/src/HtmlTplForm.cpp
    ${HTMLTPL_DIR}/src/HtmlTplEntropyZephyr.cpp
    ${HTMLTPL_DIR}/src/HtmlTplServerZephyr.cpp
)
target_include_directories(app PRIVATE ${HTMLTPL_DIR}/src)

# EVERY -D HERE, VISIBLE TO EVERY TARGET, and that is not tidiness: these knobs
# change the LAYOUT of shared types, so a library translation unit compiled
# with different values would link cleanly and then disagree about where fields
# are. target_compile_options() on `app` alone would not reach both.
zephyr_compile_definitions(
  # Forms, and therefore the CSRF token, are ON.
  HTMLTPL_FORMS=1

  # The page is compiled into the image and parsed in place, so there is no
  # filesystem template to disagree with the firmware.
  HTMLTPL_SOURCE_FS=0

  # One TCP MSS, and therefore the peak RAM cost of rendering a page of any
  # length.
  HTMLTPL_OUTBUF=1460

  # The library default is 64 and the panel is past it. Must be visible to
  # EVERY target: the registry and the library disagreeing about this is a
  # silent layout mismatch, which is why these live here.
  HTMLTPL_MAX_VARS=112
)

# Needed by the APPLICATION as well as by the bootloader, because the app
# writes the image trailer through img_mgmt and the symbol exists only in
# MCUboot's Kconfig. Without it the app takes mcuboot_config.h's 128 fallback
# and stages the pending magic where the bootloader does not look - a silent
# and very convincing failure. Must stay equal to mcuboot/pmc.conf's value.
zephyr_compile_definitions(CONFIG_BOOT_MAX_IMG_SECTORS=512)
```

## Kconfig
```
# Application Kconfig for the Portenta Machine Control Explorer.
#
# Copyright (c) 2026 Noah Christian
# SPDX-License-Identifier: MIT
#
# An application Kconfig becomes the Kconfig ROOT, so it has to source
# Kconfig.zephyr itself - and that source line must come LAST, after the
# options below, or they are not visible to a -DCONFIG_... on the command
# line.

menu "Portenta Machine Control Explorer"

config PMC_OPEN_PA1_ANALOG_SWITCH
	bool "Open the PA1 analog switch, freeing AI2 from the RMII clock"
	default y
	help
	  AI2 and the Ethernet RMII 50 MHz reference clock share the PA1/PA1_C
	  pad pair on the STM32H747, joined by a single SYSCFG analog switch.
	  Opening it separates them, which is what AI2 needs in order to read
	  anything meaningful rather than a 50 MHz clock.

	  Set this to n to leave that switch CLOSED. The only reason to do so
	  is to test whether the Ethernet MAC needs it closed to receive its
	  reference clock - with it closed, AI2 is measuring the clock and its
	  readings are meaningless. PC2 and PC3 are unaffected either way, so
	  AI0 and AI1 keep working regardless.

	  This is a genuine either/or if it turns out the clock arrives on the
	  PA1_C ball: one pad pair cannot serve an analog input and a 50 MHz
	  clock at the same time. See docs/MEASURED.md.

config PMC_ENCODER_CHANNELS
	int "How many encoder inputs to arm (0, 1 or 2)"
	default 2
	range 0 2
	help
	  A COUNT RATHER THAN A SWITCH, because it is the bisection tool.

	  Arming both channels stopped the WiFi radio answering any SDIO
	  IOCTL - measured, not suspected: with this at 0 the radio moved
	  1967 packets, with it at 2 every ioctl failed to get a buffer.
	  CAN was ruled out in the same cycle.

	  0 arms none. 1 arms ENC0 only (PJ8, PH12, PH11). 2 adds ENC1
	  (PC13, PI7, PJ10), and PC13 is the pin under suspicion: it sits on
	  the same port as SDMMC1's PC8..PC12, which is the bus the radio is
	  on, and it is the one encoder line with no alternate function at
	  all on this package.

config PMC_CANBUS
	bool "Bring up CAN on FDCAN1"
	default y
	help
	  FDCAN1 on PB8/PH13, and the transceiver's standby pin on PA13.

	  The other half of the same bisection as PMC_ENCODERS. PA13 is also
	  SWDIO, so this is the switch that gives a debugger back as well.

config PMC_CANOPEN
	bool "A minimal CANopen node on the CAN bus"
	depends on PMC_CANBUS
	default y
	help
	  Boot-up, producer heartbeat, the four NMT commands and an expedited
	  SDO server over five mandatory objects - enough that candump,
	  cansend and python-canopen see a real node rather than a controller
	  that can be made to send bytes.

	  NOT a CANopen stack. No PDOs, no segmented transfer, no SYNC, no
	  EMCY, no heartbeat consumer, no device profile. See app/src/canopen.h
	  for the full list of what is missing and why that is the honest
	  stopping point for a bring-up tool.

	  It costs one thread, and it transmits: with the heartbeat on and no
	  second node on the wire, the controller sits in ERROR_PASSIVE
	  retransmitting, which is what a lone CAN node does. Turn this off to
	  keep the bus silent, or set the heartbeat to 0 at runtime.

config PMC_CANOPEN_NODE_ID
	int "CANopen node id (1-127)"
	depends on PMC_CANOPEN
	default 5
	range 1 127
	help
	  Arbitrary, and changeable at runtime with `canopen node <n>`. It is
	  NOT remembered across a reset, deliberately: `canopen selftest`
	  asserts against a known identity, and a node id somebody has to look
	  up before trusting the output is worse than one that is always the
	  same at boot.

config PMC_CANOPEN_HEARTBEAT_MS
	int "Producer heartbeat period in ms (0 = silent until asked)"
	depends on PMC_CANOPEN
	default 0
	range 0 65535
	help
	  SILENT BY DEFAULT, AND THAT DEFAULT WAS MEASURED RATHER THAN
	  CHOSEN. At 1000 ms - the usual industrial value, and what this was
	  first set to - the node announces itself once a second whether or
	  not anything is listening. On a bench where nothing else is on the
	  wire, nothing acknowledges the frame, so the controller retries it
	  forever: after fourteen hours it had parked at ERROR_PASSIVE with a
	  transmit error count of 128, three transmit buffers permanently
	  occupied, 50,055 further sends refused outright, and the
	  transceiver driven continuously - visible as a lit TX lamp on a bus
	  the operator had never asked it to use.

	  None of that is a fault. It is what one CAN node alone on a wire
	  does, and the panel reports it accurately. It is simply not
	  something a diagnostic tool should start doing unprompted.

	  0 means the node transmits NOTHING until asked - no heartbeat and
	  no boot-up message. It still receives, still answers NMT, and still
	  answers SDO, so a master that talks to it gets a reply; what it
	  will not do is talk first. `canopen hb 1000` starts it announcing,
	  and `canopen reset` then sends the boot-up a scanner waits for.

	  This is object 0x1017, so a CANopen master can write it over SDO,
	  and a reset puts it back to this value - which is what reset
	  communication is specified to do.

config PMC_ETH_PHY_RELATCH
	bool "Pulse the Ethernet PHY's reset again before the MAC initializes"
	default y
	help
	  The LAN8742A latches its configuration straps wrong at boot - mode
	  000 instead of 111, and nINTSEL selecting nINT rather than REFCLKO,
	  so the PHY sources no RMII reference clock and the MAC's DMA reset
	  never completes. The part re-samples those straps on every rising
	  edge of nRST, so pulsing it once more fixes it. See net.c and
	  docs/MEASURED.md.

	  Set this to n ONLY to reproduce the original fault, which is what it
	  exists for: the fix works, and the reason the first latch is wrong
	  is not yet known. An experiment that raises the PHY reset
	  regulator's startup-delay-us needs this off, or the pulse hides
	  whatever the delay did.

	  With this off and no other change, Ethernet does not come up. The
	  board is still reachable over WiFi and the health gate still
	  passes, so a build with it off is safe to flash.

endmenu

source "Kconfig.zephyr"
```

## prj.conf
```kconfig
# Portenta Machine Control Explorer - application configuration.
#
# The reasoning behind these values is in docs/CONFIG.md, section by section,
# under the same headings. Anything here that looks arbitrary was paid for.

CONFIG_MAIN_STACK_SIZE=8192
# 2048 measured 75% used on the running board, and the net stack queues work
# here. A sibling Zephyr board on this bench with the same SoC and radio, up
# for 41 h, uses 4096. docs/MEASURED.md.
CONFIG_SYSTEM_WORKQUEUE_STACK_SIZE=4096

# WHD allocates from the SYSTEM heap in its SDIO data path - an MTU-sized
# buffer and a cache-alignment buffer per transfer - so a short heap drops
# packets under sustained load. CONFIG_HEAP_MEM_POOL_SIZE is only a requested
# MINIMUM: subsystems add to it, and the adds alone gave ~22.8 KB here against
# the working sibling's ~55 KB. Runtime stats so this is measurable, not
# argued.
#
# RAISED TO 128 KB SO THE USER HAS SOMETHING TO SPEND. This is the pool an
# armed RS485 capture draws on, and it is shared - WHD, getaddrinfo and the
# capture all come out of the same heap, so it is a budget rather than a
# reservation for one feature. A static ring of the same size would serve
# RS485 and nothing else.
#
# It is mostly not new RAM. COMMON_LIBC_MALLOC_ARENA_SIZE is -1, so whatever
# is not claimed statically becomes the libc arena, and nothing in this
# application calls libc malloc. Moving that leftover into the kernel heap
# makes it allocatable AND reportable: sys_heap_runtime_stats_get can see this
# pool, and cannot see the arena. docs/ARCHITECTURE.md.
CONFIG_HEAP_MEM_POOL_SIZE=131072
CONFIG_SYS_HEAP_RUNTIME_STATS=y

# A fatal error resets the board rather than halting it: no console to halt to.
CONFIG_RESET_ON_FATAL_ERROR=y

# --- Console and shell ------------------------------------------------------
CONFIG_SHELL=y
CONFIG_SHELL_BACKEND_SERIAL=y
CONFIG_LOG=y

# DIAGNOSTIC BUILD - not the shipping configuration.
#
# DEFERRED, and immediate mode is a TRAP on this board.
#
# Immediate writes each line synchronously from the calling thread. The console
# is USB CDC, so when no host is draining the endpoint that write BLOCKS - and
# with the whole net stack at level 4 the flood starts during boot. Measured
# 2026-11-17: the board wedged before WiFi came up and stopped enumerating USB
# altogether, so the console needed to recover it was the thing that killed it.
# A capture cannot be attached earlier than that, because the port does not
# exist until USB enumerates.
#
# Deferred can DROP under overflow, so absence of a line is not evidence - but
# it never blocks, which is the property that matters more here. The buffer is
# sized to the log level below.
CONFIG_LOG_MODE_DEFERRED=y
# 2 KB. It was 4 KB to survive the net-stack-at-debug build, where 16 KB
# overflowed RAM by 8,096 bytes and 8 KB left 96 BYTES of malloc arena. With
# the per-module debug gone the volume is a small fraction of that, so the
# other 2 KB goes back to the heap the user spends.
CONFIG_LOG_BUFFER_SIZE=2048
CONFIG_LOG_PROCESS_THREAD_SLEEP_MS=10

# DEFAULT STAYS AT INFO, and raising it was a mistake worth recording.
#
# smp_udp has no log symbol of its own - it registers as
# LOG_MODULE_REGISTER(smp_udp) with no level - so the default was raised to 4
# to make it verbose. MEASURED: smp_udp.c contains ZERO LOG_DBG calls (15
# LOG_ERR, 1 LOG_INF), so that bought nothing, while raising 75 modules to
# debug. Two of those floods overflowed the buffer and discarded the net-stack
# lines we were after: first the kernel and MPU, then - worse - UDC_DRIVER,
# which logs every USB endpoint transfer while the console IS USB. That is a
# feedback loop: each log line generates the traffic that generates the next.
#
# img_mgmt has 1 LOG_DBG and smp.c has none, so mcumgr debug is near-empty
# too. The signal lived entirely in the NET_* modules, which were raised one at
# a time while that was the question - see the block below for how, and what it
# cost.
CONFIG_LOG_DEFAULT_LEVEL=3

# The whole net stack. Every NET_*_LOG_LEVEL defaults to 0 while NET_LOG is
# unset (Kconfig.template.log_config.net: "default 0 if ... || !NET_LOG"), so
# without this a datagram dropped inside IP or L2 is reported by nothing at
# any level. With it they follow LOG_DEFAULT_LEVEL above.
CONFIG_NET_LOG=y

# NO PER-MODULE DEBUG. The net-stack-at-debug build that found the boot-time
# stalls and then the lost OTA datagram is finished; with NET_LOG above the
# modules follow LOG_DEFAULT_LEVEL, so errors and warnings still appear and the
# per-packet trace does not.
#
# WHAT IT COST, so the next person raising it knows what to expect. NET_PKT at
# debug was 65% of 670,000 lines and dropped more messages than it kept
# (781,997 dropped in 8,221 events), because it logs every allocation, ref,
# unref and frag of every packet. It also costs 14 KB of RAM: NET_PKT_LOG_LEVEL
# at debug selects NET_DEBUG_NET_PKT_ALLOC, whose table is sized
# NET_BUF_RX_COUNT + NET_BUF_TX_COUNT.
#
# HOW TO RAISE IT AGAIN, which is not obvious:
#
#  - Name the modules one at a time (CONFIG_NET_CORE_LOG_LEVEL_DBG=y and so
#    on), and leave NET_PKT out unless packet lifetimes are the question.
#    Raising LOG_DEFAULT_LEVEL to 4 instead drags in 75 modules, among them
#    UDC_DRIVER, which logs every USB endpoint transfer while the console IS
#    USB - a feedback loop where each line generates the traffic that
#    generates the next. That produced an 82 MB log with nothing usable in it.
#  - Use the CHOICE symbol, never the int: <MODULE>_LOG_LEVEL is derived in
#    Kconfig.template.log_config and assigning it fails the build with "not
#    directly user-assignable".
#  - Do not bother with mcumgr: smp_udp.c has ZERO LOG_DBG calls, img_mgmt has
#    one, smp.c none. The signal was entirely in the NET_* modules.
#  - A console line can be DROPPED rather than printed, and that has already
#    misled once: the /ota token diagnostic never appeared under the NET_PKT
#    flood. Put a diagnostic where its reader is guaranteed to be listening -
#    in the HTTP response, or in a counter the panel publishes.
#
# docs/MEASURED.md carries what the exercise actually found.
CONFIG_EXCEPTION_DEBUG=y
CONFIG_FAULT_DUMP=2
CONFIG_THREAD_NAME=y
CONFIG_THREAD_MONITOR=y
CONFIG_INIT_STACKS=y
CONFIG_THREAD_ANALYZER=y
CONFIG_THREAD_ANALYZER_USE_PRINTK=y
# On demand only. Automatic sampling prints over everything else.
CONFIG_THREAD_ANALYZER_AUTO=n

# --- Entropy ----------------------------------------------------------------
CONFIG_ENTROPY_GENERATOR=y
CONFIG_CSPRNG_NEEDED=y

# --- Networking -------------------------------------------------------------
CONFIG_NETWORKING=y
CONFIG_NET_IPV4=y
CONFIG_NET_IPV6=n
CONFIG_NET_TCP=y
CONFIG_NET_UDP=y
CONFIG_NET_SOCKETS=y
CONFIG_NET_DHCPV4=y
# Address conflict detection, RFC 5227. Without it a duplicate address is
# invisible: the DHCP ACK is accepted and the clash never appears in any log.
# Costs 4-7 s before the address is usable - ARP probes, then an announce wait.
CONFIG_NET_IPV4_ACD=y
# MEASURED 2026-11-18, 75 s after a cold boot: conn_mgr_monitor was at
# 472 / 512 (92%) and tcp_work at 888 / 1024 (86%), both on Zephyr defaults.
# Neither had failed, which is why they needed measuring rather than waiting
# for. `kernel thread stacks` is where these numbers come from.
CONFIG_NET_CONNECTION_MANAGER_MONITOR_STACK_SIZE=1024
CONFIG_NET_TCP_WORKQ_STACK_SIZE=1536
CONFIG_NET_CONNECTION_MANAGER=y
CONFIG_NET_MGMT=y
CONFIG_NET_MGMT_EVENT=y
CONFIG_NET_L2_ETHERNET=y
# Two interfaces, so two IPv4 configs. At the default of 1 they race and the
# loser reports "IPv4 not enabled for this interface".
CONFIG_NET_IF_MAX_IPV4_COUNT=2
# ETHERNET IS PREFERRED, BUT THE REAL CHOICE IS MADE AT RUNTIME.
#
# This symbol only sets the default at boot, before any link exists. It is
# Ethernet because that is the faster path by better than ten to one - about
# 1,040 kB/s against 85 over the radio - and because it shares none of the RF
# path that made OTA uploads fail half the time.
#
# A compile-time setting cannot know whether a cable is plugged in, and a
# default interface that is down is worse than the slower one that is up. So
# pmc_net_pick_default() in net.c revisits it on every link poll and falls back
# to the radio whenever Ethernet has no carrier or no address. Changing this
# symbol alone would NOT give a fallback.
CONFIG_NET_DEFAULT_IF_ETHERNET=y
# After the PHY's reset regulator at 75, before NET_INIT_PRIO at 90. MDIO comes
# after the MAC because its node is a child of it. Measured; see docs/CONFIG.md.
CONFIG_ETH_INIT_PRIORITY=80
CONFIG_MDIO_INIT_PRIORITY=81
CONFIG_PHY_INIT_PRIORITY=82
# Sized for 4 concurrent clients, derived rather than maximized. A fragment is
# 128 bytes of payload plus a 28-byte descriptor, so each buffer costs 156, and
# a 1500-byte frame chains 12 of them.
#
# RX: 4 x 4 KB receive window = 128 fragments. 256 doubles that for ARP, DHCP,
# mDNS and the SMP/UDP transfer, which share the pool.
# TX: 4 x 8 KB send window = 256 fragments unacked worst case, plus margin.
#
# THE CEILING IS THE MALLOC ARENA, not the 512 KB. COMMON_LIBC_MALLOC_ARENA_SIZE
# is -1, so the arena is whatever RAM is left over. At the previous 1024/512 the
# arena was down to about 2.5 KB; raising these takes it silently.
#
# The previous maximum (1024/512) was a test, not a setting. It did NOT fix the
# intermittent OTA stall - see docs/MEASURED.md.
CONFIG_NET_PKT_RX_COUNT=64
CONFIG_NET_PKT_TX_COUNT=64
CONFIG_NET_BUF_RX_COUNT=256
CONFIG_NET_BUF_TX_COUNT=320
# Declared, not derived. At 0 the window is NET_BUF_*_COUNT * 128 / 3, so it
# moved whenever the pool moved: at 1024 it advertised 43 KB per connection
# against a 131 KB pool, oversubscribed 4 ways.
CONFIG_NET_TCP_MAX_RECV_WINDOW_SIZE=4096
CONFIG_NET_TCP_MAX_SEND_WINDOW_SIZE=8192
# One connection handler per listening socket, and the default was one short.
CONFIG_NET_MAX_CONN=16
CONFIG_NET_MAX_CONTEXTS=16
CONFIG_NET_SHELL=y
CONFIG_WIFI=y
CONFIG_WIFI_AIROC=y
# Both set explicitly: Kconfig.defconfig selects them only `if BT`.
CONFIG_CYW4343W=y
CONFIG_CYW4343W_MURATA_1DX=y
CONFIG_WIFI_CREDENTIALS=y
# Credentials live in NVS, never in this build. See docs/PROVISIONING.md.
CONFIG_WIFI_CREDENTIALS_STATIC=n
CONFIG_WIFI_CREDENTIALS_BACKEND_SETTINGS=y
CONFIG_NET_L2_WIFI_SHELL=y
CONFIG_WHD_WIFI_COUNTRY="WHD_COUNTRY_UNITED_STATES"

# --- Discovery: portentaexplorer.local --------------------------------------
# RESPONDER, not RESOLVER: this answers for its own name.
CONFIG_MDNS_RESPONDER=y
CONFIG_DNS_SD=y
CONFIG_NET_HOSTNAME_ENABLE=y
# Lowercase, and NOT NET_HOSTNAME_UNIQUE - the name must be predictable.
CONFIG_NET_HOSTNAME="portentaexplorer"
CONFIG_ZVFS_EVENTFD_MAX=4

# --- C++, for the template engine -------------------------------------------
# One translation unit is C++: src/page_vars.cpp, the HtmlTpl registry.
CONFIG_CPP=y
CONFIG_STD_CPP17=y
CONFIG_CPP_EXCEPTIONS=n
CONFIG_CPP_RTTI=n

# --- HTTP server ------------------------------------------------------------
CONFIG_HTTP_SERVER=y
# Request headers are readable only in the first callback, so they are captured.
CONFIG_HTTP_SERVER_CAPTURE_HEADERS=y
# 64, AND 32 SILENTLY BROKE THE UPLOAD TOKEN. This sizes one buffer that the
# parser reuses for a header's NAME and then its VALUE, so the limit applies to
# whichever is longer. The API token is 32 characters, which needs 33 bytes with
# its terminator, so on_header_value discarded it at LOG_DBG level and the
# header was simply never captured - POST /ota then refused every upload for a
# missing token. The macro's BUILD_ASSERT only checks the name, so the build
# was clean. Measured 2026-11-18.
CONFIG_HTTP_SERVER_MAX_HEADER_LEN=64
# The POST path puts hex[514] and raw[256] on this stack for a 256-byte RS485
# frame, so 4096 no longer has margin.
CONFIG_HTTP_SERVER_STACK_SIZE=8192
CONFIG_HTTP_SERVER_VERSION_2=n
# Four clients, each one a measured 1.57 KB of the static server context. The
# page is one self-contained document, so a browser holds one connection, not
# one per asset. A fifth client is accepted and closed immediately.
CONFIG_HTTP_SERVER_MAX_CLIENTS=4
# The streams array is allocated whether or not HTTP/2 is on, and it is off.
CONFIG_HTTP_SERVER_MAX_STREAMS=1
# A 256-byte RS485 frame posts as 512 hex characters, so the request line plus
# that body no longer fits in 512.
CONFIG_HTTP_SERVER_CLIENT_BUFFER_SIZE=1024
CONFIG_ZVFS_POLL_MAX=16

# --- Carrier I/O subsystems -------------------------------------------------
CONFIG_I2C=y
CONFIG_ADC=y
CONFIG_GPIO=y
CONFIG_MDIO_SHELL=y
CONFIG_I2C_SHELL=y
CONFIG_ADC_SHELL=y
CONFIG_GPIO_SHELL=y

# --- Flash, filesystem, settings --------------------------------------------
CONFIG_FLASH=y
CONFIG_FLASH_MAP=y
CONFIG_FLASH_PAGE_LAYOUT=y
CONFIG_STREAM_FLASH=y
CONFIG_MPU_ALLOW_FLASH_WRITE=y
# Silences SD retry noise on a board with no card. This DOES hide real errors.
CONFIG_SDHC_LOG_LEVEL_OFF=y
CONFIG_FILE_SYSTEM=y
CONFIG_FILE_SYSTEM_LITTLEFS=y
CONFIG_SETTINGS=y
CONFIG_SETTINGS_NVS=y

# Why this board asks the hardware why it restarted.
#
# Without it there was no reset cause at all here: `whoami` could say which
# image was running and since when, but not what ended the run before it. The
# cause register is also the thing that must be cleared each boot, or the next
# reading is a union of every boot since power-on -- which is why whoami.c
# reads it once, clears it, and stores it, rather than leaving it for whoever
# asks first.
CONFIG_HWINFO=y
CONFIG_NVS=y

# --- Device management: SMP over UDP ----------------------------------------
CONFIG_ZCBOR=y
CONFIG_MCUMGR=y
CONFIG_MCUMGR_TRANSPORT_UDP=y
# Not automatic: the socket must be opened after an address exists, not at boot.
CONFIG_MCUMGR_TRANSPORT_UDP_AUTOMATIC_INIT=n
CONFIG_MCUMGR_GRP_IMG=y
CONFIG_MCUMGR_GRP_OS=y
CONFIG_MCUMGR_TRANSPORT_NETBUF_SIZE=2048
CONFIG_IMG_MANAGER=y
CONFIG_IMG_ERASE_PROGRESSIVELY=y

# --- MCUboot ----------------------------------------------------------------
CONFIG_BOOTLOADER_MCUBOOT=y
# Must match the bootloader's own swap mode. Watch the three near-identical
# symbol names - the wrong one makes MCUboot refuse every update in silence.
CONFIG_MCUBOOT_BOOTLOADER_MODE_SWAP_SCRATCH=y
CONFIG_MCUBOOT_IMGTOOL_SIGN_VERSION="0.12.0+147"

# --- CAN on the HMI connector, through FDCAN1 -------------------------------
#
# CONFIG_CAN_RX_THREAD_STACK_SIZE DOES NOT EXIST in this Zephyr and setting it
# fails the build rather than being ignored, which is the good outcome: the
# MCAN driver delivers a received frame from its own interrupt context, so
# there is no RX thread to size. The filter callback in canbus.c therefore
# runs in an ISR and does nothing but copy bytes into a ring.
CONFIG_CAN=y
CONFIG_CAN_STM32H7_FDCAN=y

# --- Real-time clock --------------------------------------------------------
CONFIG_RTC=y

# --- Analog out -------------------------------------------------------------
CONFIG_PWM=y

# --- NTP, and the DNS it needs to find a server -----------------------------
# A hostname is the only option here, not merely the nicer one.
CONFIG_DNS_RESOLVER=y
CONFIG_NET_DHCPV4_OPTION_DNS_ADDRESS=y
# Zephyr defaults to 1, and DHCP hands out a primary and a backup. With 1 the
# backup is parsed and discarded, so a dead primary means no resolution at all.
# Each server costs one network context out of CONFIG_NET_MAX_CONTEXTS.
CONFIG_DNS_RESOLVER_MAX_SERVERS=2
CONFIG_SNTP=y

# --- Temperature ------------------------------------------------------------
CONFIG_SPI=y
CONFIG_SENSOR=y
CONFIG_MAX31855=y
CONFIG_MAX31865=y

# --- RS485 / RS232 ----------------------------------------------------------
CONFIG_SERIAL=y
CONFIG_UART_INTERRUPT_DRIVEN=y
# Runtime baud changes, for the rate sweep and the panel's baud selector.
CONFIG_UART_USE_RUNTIME_CONFIGURE=y

# --- Network pool instrumentation -------------------------------------------
# These are how a buffer theory gets tested instead of argued.
CONFIG_NET_BUF_POOL_USAGE=y
CONFIG_NET_STATISTICS=y
CONFIG_NET_STATISTICS_USER_API=y
CONFIG_NET_STATISTICS_WIFI=y
CONFIG_NET_STATISTICS_UDP=y

# --- SMP transport buffers --------------------------------------------------
# Costs 2 x NETBUF_SIZE, so 4 kB here.
CONFIG_MCUMGR_TRANSPORT_NETBUF_COUNT=4
```

## boards/arduino_portenta_h7_stm32h747xx_m7.overlay
```dts
/*
 * Application overlay for the Portenta H7 carrying the Machine Control.
 *
 * The flash map is NOT written here. It is included from the repository root
 * so that MCUboot's own build includes the identical file - see the comment at
 * the top of pmc-partitions.dtsi for what goes wrong when the two disagree,
 * which is nothing visible until a swap.
 */

#include "../../pmc-partitions.dtsi"
```

## src/main.c
```c
/*
 * Portenta Machine Control Explorer.
 *
 * SPDX-License-Identifier: MIT
 * Written by Noah Christian (C) 2026
 *
 * M0 STATE. This does nothing with the carrier's I/O yet, on purpose. M0
 * exists to produce two measurements, and both of them constrain decisions
 * that are expensive to change afterwards:
 *
 *   1. The size of an image with WiFi compiled in. The AIROC 4343WA1 firmware
 *      is 421,421 bytes and there is no Kconfig to load it from the QSPI
 *      airoc_firmware partition, so it is linked INTO the image. That single
 *      number decides whether two internal MCUboot slots are possible at all.
 *      They are not: see docs/FLASH.md.
 *
 *   2. What the three analog inputs actually read. The STM32H747's SYSCFG
 *      analog switches are CLOSED after reset, and on this board that ties
 *      PA_1C/PC_2C/PC_3C - the carrier's three analog inputs - to the Ethernet
 *      RMII clock and to SPI2. Nothing in Zephyr opens them. See
 *      boards/shields/.../pmc_syscfg_init.c.
 *
 * The board has NO display of any kind. The USB CDC-ACM shell and, later, the
 * web panel are the only two ways to see anything, which is why the shell
 * commands here are not a convenience.
 */

#include <zephyr/kernel.h>
#include <zephyr/device.h>
#include <zephyr/devicetree.h>
#include <zephyr/logging/log.h>
#include <zephyr/shell/shell.h>
#include <zephyr/storage/flash_map.h>
#include <zephyr/drivers/flash.h>

#include "clock.h"
#include "expander.h"
#include "ao.h"
#include "temp.h"
#include "rs485.h"
#include "io_write.h"
#include "persist.h"
#include "whoami.h"
#include "enc.h"
#include "canbus.h"
#include "canopen.h"
#include "page_vars.h"


LOG_MODULE_REGISTER(pmc, LOG_LEVEL_INF);

/*
 * Entropy, asserted rather than assumed.
 *
 * CONFIG_CSPRNG_NEEDED is a request; CONFIG_CSPRNG_ENABLED is the answer, and
 * the answer can be no even with an entropy node in the devicetree, because
 * the driver may be gated by some other Kconfig that is not set. Zephyr's own
 * help text says to enable the first and then check the second.
 *
 * It matters here more than it looks. The web panel's form layer refuses EVERY
 * write when its CSRF token has no entropy behind it - deliberately failing
 * closed rather than seeding from uptime, which would produce a token that
 * looks exactly right and is guessable. A silent "no" here therefore surfaces
 * much later as a panel whose buttons all appear to do nothing, with nothing
 * in any log to say why. Failing the BUILD is cheaper.
 */
BUILD_ASSERT(IS_ENABLED(CONFIG_CSPRNG_ENABLED),
	     "no cryptographically secure entropy source was pulled into this "
	     "build; the panel would refuse every write at runtime");

/*
 * Every partition this application believes in, by nodelabel.
 *
 * Printed rather than assumed. The flash map is the one thing MCUboot and this
 * application MUST agree about, and when they disagree nothing fails loudly:
 * MCUboot writes, validates and swaps at addresses the application does not
 * share, and the symptom is a corrupt image or a silently ignored update
 * rather than a build error. Both sides include pmc-partitions.dtsi, and this
 * command is how you check that the include actually took effect - in
 * particular that the /delete-node/ of the board's own internal slot1 and
 * scratch resolved, instead of quietly leaving the old nodes in place.
 */
struct part_row {
	const char *name;
	uint8_t     id;
};

static int cmd_pmc_parts(const struct shell *sh, size_t argc, char **argv)
{
	ARG_UNUSED(argc);
	ARG_UNUSED(argv);

	static const struct part_row rows[] = {
#if PARTITION_EXISTS(boot_partition)
		{ "boot_partition  (mcuboot)", PARTITION_ID(boot_partition) },
#endif
#if PARTITION_EXISTS(slot0_partition)
		{ "slot0_partition (image-0)", PARTITION_ID(slot0_partition) },
#endif
#if PARTITION_EXISTS(slot1_partition)
		{ "slot1_partition (image-1)", PARTITION_ID(slot1_partition) },
#endif
#if PARTITION_EXISTS(scratch_partition)
		{ "scratch_partition", PARTITION_ID(scratch_partition) },
#endif
#if PARTITION_EXISTS(web_partition)
		{ "web_partition (LittleFS)", PARTITION_ID(web_partition) },
#endif
#if PARTITION_EXISTS(kvs_partition)
		{ "kvs_partition (settings)", PARTITION_ID(kvs_partition) },
#endif
	};

	shell_print(sh, "%-28s %-10s %-10s %-9s %s",
		    "partition", "offset", "size", "sector", "device");

	for (size_t i = 0; i < ARRAY_SIZE(rows); i++) {
		const struct flash_area *fa;
		int rc = flash_area_open(rows[i].id, &fa);

		if (rc != 0) {
			shell_print(sh, "%-28s  open failed (%d)", rows[i].name, rc);
			continue;
		}

		/*
		 * The erase-block size is printed because it is the number the
		 * swap turns on. MCUboot's boot_slots_compatible() compares
		 * sector geometry between the slots, and the scratch area has
		 * to be STRICTLY larger than the largest sector it must hold -
		 * an exactly-equal scratch passes the compatibility check and
		 * then fails during the swap itself, because a scratch trailer
		 * is written into the same area. 128 KB internally against
		 * 4 KB in the QSPI NOR is exactly why this layout needs
		 * swap-using-scratch and cannot use swap-using-move.
		 */
		const struct device *dev = flash_area_get_device(fa);
		struct flash_pages_info pg;
		size_t sector = 0;

		if (dev != NULL && flash_get_page_info_by_offs(dev, fa->fa_off, &pg) == 0) {
			sector = pg.size;
		}

		shell_print(sh, "%-28s 0x%08lx 0x%08zx %-9zu %s",
			    rows[i].name,
			    (unsigned long)fa->fa_off,
			    (size_t)fa->fa_size,
			    sector,
			    dev != NULL ? dev->name : "(none)");

		flash_area_close(fa);
	}

	return 0;
}

SHELL_STATIC_SUBCMD_SET_CREATE(sub_pmc,
	SHELL_CMD(parts, NULL,
		  "Print every flash partition this image believes in.",
		  cmd_pmc_parts),
	SHELL_SUBCMD_SET_END
);

SHELL_CMD_REGISTER(pmc, &sub_pmc, "Portenta Machine Control Explorer", NULL);

int main(void)
{
	LOG_INF("Portenta Machine Control Explorer");
	LOG_INF("board %s", CONFIG_BOARD_TARGET);

	/*
	 * The panel is NOT started here. zsock_bind() returns ENOENT while no
	 * interface has an address, so a server started from main() binds
	 * nothing and never retries - see the L4_CONNECTED handler in net.c,
	 * which starts it when there is actually something to bind to.
	 *
	 * Its SELF-TEST is here, though, and that split is deliberate twice
	 * over. It renders the whole page to a counting sink and logs every
	 * tag that does not resolve against the registry in page_vars.cpp, so a
	 * generated header that no longer matches the registry is a line in the
	 * boot log rather than a hole somebody notices in a browser an hour
	 * later - and it runs now rather than on first request, because the
	 * point of a self-test is to have already run.
	 *
	 * AND IT HAS TO BE ON THIS STACK. HtmlTpl::render() puts its
	 * HTMLTPL_OUTBUF coalescing buffer on the caller's stack, which is 1460
	 * bytes; CONFIG_MAIN_STACK_SIZE is raised to 8192 to hold it. Calling
	 * it from the L4 handler instead put it on the 2048-byte system
	 * workqueue stack and faulted the board on its first boot.
	 */
	pmc_page_init();

	/*
	 * Started here rather than from the network event, because it owns a
	 * thread and a thread is created once, from a stack that is known. It
	 * blocks until an address exists, so starting it early costs nothing.
	 */
	pmc_clock_init();

	/* Configures the expander input pins. A failure here is reported and
	   not fatal: the rest of the panel still works without DIN. */
	(void)pmc_io_init();
	(void)pmc_io_write_init();
	(void)pmc_ao_init();
	/* Temperature starts its own sweep thread; a failure here is
	 * reported by the health check rather than stopping boot. */
	(void)pmc_temp_init();
	(void)pmc_rs485_init();
	/*
	 * Encoders arm six GPIO interrupts; CAN brings up FDCAN1 and drives
	 * the transceiver's standby pin. Both report their own failures and
	 * neither is allowed to stop the panel coming up.
	 *
	 * Each has a Kconfig that turns it off, and they are there to be used:
	 * these two arrived together and the radio stopped answering in the
	 * same build, which is a question one flash cycle settles and an
	 * argument does not.
	 */
	/* pmc_enc_init() honors CONFIG_PMC_ENCODER_CHANNELS itself, including
	   0, so there is no guard here - one place decides how many. */
	(void)pmc_enc_init();
	if (IS_ENABLED(CONFIG_PMC_CANBUS)) {
		(void)pmc_can_init();
		/*
		 * AFTER the controller, because it installs the receive tap
		 * and pmc_can_init() is what adds the filter that feeds it.
		 * It also starts transmitting a heartbeat, which on a wire
		 * with no second node leaves the controller retransmitting in
		 * ERROR_PASSIVE - that is what a lone CAN node does, it is
		 * reported rather than hidden, and CONFIG_PMC_CANOPEN turns
		 * it off.
		 */
		if (IS_ENABLED(CONFIG_PMC_CANOPEN)) {
			(void)pmc_canopen_init();
		}
	}

	/*
	 * LAST, AND THAT ORDER IS THE WHOLE POINT. pmc_persist_init() applies
	 * the stored RS485 line settings and probe type through the same
	 * setters a person would use, so the drivers it configures have to
	 * exist first. It does NOT touch an output - those go back from the
	 * health thread, once every check has passed (persist.h).
	 */
	(void)pmc_persist_init();

	/*
	 * AFTER pmc_persist_init(), because that is what runs
	 * settings_subsys_init() and the boot history lives in settings.
	 * Recording this boot before the subsystem exists would write nothing
	 * and leave a history claiming the board has never started.
	 *
	 * It also reads and CLEARS the reset cause, so this must be the only
	 * caller -- a second reader would find the register already wiped and
	 * report "unavailable" for a boot whose cause is sitting in the ring.
	 */
	whoami_history_begin();

	/*
	 * Deliberately not a busy loop and deliberately not a k_sleep(FOREVER)
	 * either: main returning is fine in Zephyr, the shell and the network
	 * stack run on their own threads, and leaving a thread parked here
	 * would only cost a stack.
	 */
	return 0;
}
```

## src/ao.c
```c
/*
 * Analog out. Why nothing here can say "verified" is in ao.h.
 *
 * SPDX-License-Identifier: MIT
 * Written by Noah Christian (C) 2026
 */

#include <errno.h>
#include <stdlib.h>
#include <string.h>

#include <zephyr/kernel.h>
#include <zephyr/devicetree.h>
#include <zephyr/drivers/pwm.h>
#include <zephyr/logging/log.h>
#include <zephyr/sys/printk.h>

#include "ao.h"

LOG_MODULE_REGISTER(pmc_ao, LOG_LEVEL_INF);

static const struct pwm_dt_spec ao_pwm[] = {
	PWM_DT_SPEC_GET(DT_NODELABEL(ao0)),
	PWM_DT_SPEC_GET(DT_NODELABEL(ao1)),
	PWM_DT_SPEC_GET(DT_NODELABEL(ao3)),
};

/* Channel number -> index into ao_pwm, or -1. AO2 is the hole. */
static const int8_t ao_slot[PMC_AO_COUNT] = { 0, 1, -1, 2 };

static int32_t s_mv[PMC_AO_COUNT] = { -1, -1, -1, -1 };
static bool s_ready;

bool pmc_ao_available(int n)
{
	return n >= 0 && n < PMC_AO_COUNT && ao_slot[n] >= 0;
}

int32_t pmc_ao_commanded(int n)
{
	if (n < 0 || n >= PMC_AO_COUNT) {
		return -1;
	}
	return s_mv[n];
}

int pmc_ao_init(void)
{
	for (size_t i = 0; i < ARRAY_SIZE(ao_pwm); i++) {
		if (!pwm_is_ready_dt(&ao_pwm[i])) {
			LOG_ERR("AO pwm %u not ready", (unsigned)i);
			return -ENODEV;
		}
	}

	/*
	 * Every channel to zero before anything else can set one. An analog
	 * output that comes up at whatever the timer happened to hold is a
	 * 0-10 V signal nobody asked for, and after an OTA revert the previous
	 * image's setpoints are exactly what would otherwise persist.
	 */
	for (int n = 0; n < PMC_AO_COUNT; n++) {
		if (!pmc_ao_available(n)) {
			continue;
		}
		(void)pwm_set_pulse_dt(&ao_pwm[ao_slot[n]], 0);
		s_mv[n] = 0;
	}

	s_ready = true;
	LOG_INF("AO ready: AO0, AO1, AO3 (AO2 is HRTIM, unavailable)");
	return 0;
}

enum pmc_write_result pmc_ao_set(const char *chan, uint32_t mv,
				 char *detail, size_t cap)
{
	int n;
	uint32_t pulse;
	int rc;

	if (!s_ready) {
		(void)snprintk(detail, cap, "AO not initialized");
		return PMC_W_ERROR;
	}
	if (chan == NULL || strncmp(chan, "AO", 2) != 0) {
		(void)snprintk(detail, cap, "%s is not an analog output",
			       chan ? chan : "(none)");
		return PMC_W_REFUSED;
	}

	n = atoi(chan + 2);
	if (n < 0 || n >= PMC_AO_COUNT) {
		(void)snprintk(detail, cap, "%s is not a channel", chan);
		return PMC_W_REFUSED;
	}
	if (!pmc_ao_available(n)) {
		(void)snprintk(detail, cap,
			       "AO%d is driven by HRTIM, which Zephyr has no "
			       "driver for - not available in this image", n);
		return PMC_W_REFUSED;
	}
	if (mv > PMC_AO_MAX_MV) {
		(void)snprintk(detail, cap, "%u mV is above the %u mV maximum",
			       (unsigned)mv, (unsigned)PMC_AO_MAX_MV);
		return PMC_W_REFUSED;
	}

	/*
	 * Scaled against the arithmetic full scale, not the 10 V maximum, so a
	 * 10 V request asks for about 92% duty rather than 100%. If the real
	 * transfer differs this is where it gets corrected - once a meter has
	 * said what it actually is.
	 */
	pulse = (uint32_t)(((uint64_t)ao_pwm[ao_slot[n]].period * mv) /
			   PMC_AO_FULL_MV);

	rc = pwm_set_pulse_dt(&ao_pwm[ao_slot[n]], pulse);
	if (rc != 0) {
		(void)snprintk(detail, cap, "pwm_set_pulse failed (%d)", rc);
		return PMC_W_ERROR;
	}

	s_mv[n] = (int32_t)mv;
	(void)snprintk(detail, cap,
		       "AO%d set to %u mV (%u%% duty) - no sense path exists "
		       "on this family and the volts-to-duty transfer is "
		       "unmeasured, so this is a command, not a reading",
		       n, (unsigned)mv,
		       (unsigned)((pulse * 100U) / ao_pwm[ao_slot[n]].period));
	return PMC_W_COMMANDED;
}
```

## src/ao.h
```c
/*
 * Analog out: a PWM, a filter and an amplifier - not a DAC.
 *
 * SPDX-License-Identifier: MIT
 * Written by Noah Christian (C) 2026
 *
 * Datasheet 3-7: each channel is a PWM through a double low-pass filter into a
 * non-inverting amplifier of gain 3.3. So the terminal voltage is a function
 * of duty cycle, and resolution and settling are properties of the filter.
 *
 * THE VOLTS-TO-DUTY TRANSFER IS NOT MEASURED. A 3.3 V logic swing through a
 * gain of 3.3 implies about 10.9 V at full duty, which is where the scaling
 * below comes from - but that is arithmetic from two datasheet numbers, not a
 * reading. Until a meter has been on a terminal, every setpoint reports `set
 * (not verified)` and the panel says the transfer is unmeasured.
 *
 * AND THERE IS NO READ-BACK AT ALL. No sense path exists on any AO channel, so
 * `verified` is not reachable here even in principle. Confirming a setpoint
 * means a meter, or looping the output into an analog input.
 *
 * AO2 IS ABSENT. It is PG_7, driven by HRTIM - a peripheral Zephyr has no
 * driver for and which carries no tim*_ch* function in the pinctrl file.
 */
#ifndef PMC_AO_H
#define PMC_AO_H

#include <stdbool.h>
#include <stdint.h>

#include "io_write.h"

#ifdef __cplusplus
extern "C" {
#endif

#define PMC_AO_COUNT   4
#define PMC_AO_MAX_MV  10000U

/* Full scale at 100% duty, from 3.3 V x 3.3. Arithmetic, not a measurement. */
#define PMC_AO_FULL_MV 10890U

int pmc_ao_init(void);

/* Set one channel by name - "AO0". Refuses AO2 and anything out of range. */
enum pmc_write_result pmc_ao_set(const char *chan, uint32_t mv,
				 char *detail, size_t cap);

/* Last commanded millivolts, or -1 for a channel that cannot be driven. */
int32_t pmc_ao_commanded(int n);

/* True when the channel exists in this build (false for AO2). */
bool pmc_ao_available(int n);

#ifdef __cplusplus
}
#endif

#endif /* PMC_AO_H */
```

## src/auth.h
```c
/*
 * The write token.
 *
 * SPDX-License-Identifier: MIT
 * Written by Noah Christian (C) 2026
 *
 * PROVISIONED, NOT COMPILED IN (changed 2026-11-19). The token lives in the
 * `kvs` NVS partition, put there once per board over the serial shell by
 * tools/token_provision.ps1. It is not in the firmware, so the image carries
 * no secret at all and can be published, attached to a release, or handed to
 * somebody else unchanged.
 *
 * It used to be `#define SECRET_API_TOKEN` pulled in from app_secrets.h and
 * compared as a string literal, which put it in the binary as plain ASCII:
 * a byte search found it at one offset in zephyr.signed.bin and `strings` was
 * the whole attack. That was written down in this file and accepted, which was
 * tolerable while the artifact never left the bench and stopped being so the
 * moment a public release could carry it.
 *
 * This also makes the token a property of the BOARD rather than of the build.
 * Two boards running the identical image now hold different tokens, one can be
 * rotated without a rebuild, and an OTA can no longer move a credential from
 * one unit to another by accident.
 *
 * NVS HOLDS IT IN THE CLEAR, and that is a decision rather than an oversight.
 * Hashing would defend against someone who can read the QSPI chip - but that
 * someone is holding the board, and the terminals are right there; the token
 * guards the network path, not the screwdriver. It would also have meant a
 * crypto dependency in an image that currently has none, to defend the one
 * copy that never leaves the unit. The copy that travels is the one that
 * mattered, and it is gone.
 *
 * FAIL CLOSED, AND BUILDABLE WITHOUT IT. A board with nothing provisioned
 * serves the panel read-only and refuses every write, saying so on the page.
 * That is also the state of a freshly flashed board, deliberately: an
 * un-provisioned unit should not be writable, and "the token did not survive
 * the update" must look different from "there is no token".
 *
 * The NVS partition sits outside both image slots, so provisioning survives
 * every OTA - the same property that makes the WiFi credentials a one-time
 * step in tools/wifi_provision.ps1.
 *
 * WHAT THIS IS AND IS NOT. It is a shared secret over plain HTTP on a LAN. It
 * stops a stray request and an unauthorized script; it does not stop anyone
 * who can read the traffic. On a board whose outputs switch 24 V that limit
 * should be understood rather than papered over - the honest fix is a network
 * you trust, not a longer token. Moving the token out of the image did not
 * change this, and nothing about provisioning should be read as having done.
 *
 * CSRF: NOT ENFORCED, and this comment used to say it was. It read "the token
 * here authorizes, HtmlTplForm's token proves the request came from a page
 * this board rendered - a write needs both". The engine does carry a CSRF
 * token and the page does render one, but NOTHING IN THE WRITE PATH CHECKS
 * IT: io_post.cpp gates on this token alone. Proved on the running board -
 * a POST with the correct token, no CSRF field and no Referer reached the
 * verb dispatcher (2026-11-18, docs/MEASURED.md).
 *
 * A doc comment claiming a control that does not exist is worse than no
 * comment, because it is the thing somebody quotes when asked what guards
 * the board. Either wire the check in, or say this.
 *
 * SO: THE TOKEN IS THE ONLY GATE on a write, and anything that knows it can
 * write from anywhere that can reach the port.
 */
#ifndef PMC_AUTH_H
#define PMC_AUTH_H

#include <stdbool.h>
#include <stddef.h>
#include <stdint.h>

#ifdef __cplusplus
extern "C" {
#endif

/*
 * A floor, not a style guide. Below this the token is guessable over a LAN
 * faster than anyone would notice the refusals, and there is no reason to
 * accept one: the provisioning script generates 32 characters. It was a
 * BUILD_ASSERT when the token was compiled in; the check has to happen at
 * provisioning time now, which is also where a person can be told about it.
 */
#define PMC_AUTH_TOKEN_MIN 16
#define PMC_AUTH_TOKEN_MAX 64

/* True when a token is provisioned. False means every write is refused. */
bool pmc_auth_configured(void);

/*
 * Constant-time compare against the provisioned token. Returns false when
 * none is provisioned, when `presented` is NULL, or when it does not match.
 *
 * Constant time because a byte-at-a-time compare leaks the token's prefix to
 * anyone willing to time the refusals, and this is cheap enough that there is
 * no reason to take that trade.
 */
bool pmc_auth_ok(const char *presented);

/*
 * Store a token in NVS, replacing any existing one. Returns 0, or -EINVAL
 * when the length is outside [PMC_AUTH_TOKEN_MIN, PMC_AUTH_TOKEN_MAX], or the
 * settings backend's error.
 *
 * The RAM copy is only updated once the write to flash has succeeded, so a
 * failed save leaves the board answering to the token it already had rather
 * than to one that exists nowhere.
 */
int pmc_auth_set(const char *tok);

/* Forget the provisioned token. The board is read-only afterwards. */
int pmc_auth_clear(void);

/* Length of the provisioned token, 0 when there is none. For reporting the
   state of provisioning without reporting the token. */
size_t pmc_auth_len(void);

/* Refusals since boot, for the panel. A gate nobody can see refuse is a gate
   nobody has seen work. */
uint32_t pmc_auth_refusals(void);
void pmc_auth_note_refusal(void);

#ifdef __cplusplus
}
#endif

#endif /* PMC_AUTH_H */
```

## src/do_interlock.h
```c
/*
 * Interlock (0): every digital output starts de-energized.
 *
 * SPDX-License-Identifier: MIT
 * Written by Noah Christian (C) 2026
 *
 * This header used to declare pmc_status_set(), which drove DO1 as a boot
 * indicator. That is gone - see do_interlock.c for what it was, why it was
 * worth having, and what was given up by removing it.
 *
 * Nothing is exported now. The interlock runs from SYS_INIT at POST_KERNEL 45
 * and the `dowalk` shell command registers itself, so there is no entry point
 * for anything else to call. The header remains so that the file has a place
 * to state what it guarantees:
 *
 *   By the time any application code runs, all eight digital outputs have
 *   been configured as outputs, driven low, and the shared latch pulsed.
 *
 * Remembered outputs (persist.h) are restored AFTER that, from the health
 * thread, and only once every check has passed.
 */
#ifndef PMC_DO_INTERLOCK_H
#define PMC_DO_INTERLOCK_H

/* True once every health check has passed. Declared in health.h. */
bool pmc_health_is_healthy(void);

#endif /* PMC_DO_INTERLOCK_H */
```
